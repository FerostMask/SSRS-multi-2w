/*--------------------------------------------------------------*/
/*							头文件加载							*/
/*==============================================================*/
#include "menu.h"
#include "Init.h"
//#include "menu_2.h"
#include "string.h"
#include "zf_gpio.h"
#include "SEEKFREE_IPS200_PARALLEL8.h"
/*--------------------------------------------------------------*/
/*							  宏定义							*/
/*==============================================================*/
//	菜单行数
#define rows 4
//	菜单列限制
#define limit0 2
#define limit1 3
#define limit2 2
#define limit3 2
#define index_limit 3
/*--------------------------------------------------------------*/
/* 							 函数定义 							*/
/*==============================================================*/

//----------------------------分割线----------------------------//
/*--------------------------------------------------------------*/
/* 							 一级菜单 							*/
/*==============================================================*/
/*------------------------------*/
/*		 菜单信息存储模块		*/
/*==============================*/
static char info(char index, char num){
//	变量定义
	register unsigned char i;
//	字模
	unsigned char ti0[] = {0x08,0x40,0x08,0x40,0x08,0x40,0x10,0x40,0x17,0xFC,0x30,0x40,0x30,0xE0,0x50,0xE0,0x91,0x50,0x11,0x50,0x12,0x48,0x15,0xF4,0x18,0x42,0x10,0x40,0x10,0x40,0x10,0x40};//体
	unsigned char you0[] = {0x00,0x00,0x00,0x00,0x10,0x20,0x10,0x20,0x21,0xF8,0x26,0x26,0x24,0x22,0x44,0x22,0x78,0x42,0x08,0x42,0x14,0x42,0x14,0x42,0x22,0x42,0x22,0x84,0x7E,0x84,0x03,0x3C};//幼
	unsigned char yuan0[] = {0x00,0x00,0x00,0x00,0x7F,0xFE,0x47,0xE2,0x48,0x12,0x48,0x12,0x47,0xE2,0x4F,0xF2,0x50,0x12,0x50,0x12,0x51,0x12,0x51,0x12,0x42,0x92,0x44,0x72,0x58,0x0A,0x3F,0xFC};//圆
	unsigned char hei0[] = {0x00,0x00,0x3F,0xFC,0x21,0x84,0x2D,0xB4,0x25,0xA4,0x27,0xE4,0x3F,0xFC,0x01,0x80,0x3F,0xFC,0x01,0x80,0x01,0x80,0x7F,0xFE,0x20,0x44,0x26,0x44,0x62,0x66,0x00,0x00};//黑
	unsigned char cai0[] = {0x08,0x20,0x08,0x20,0xFF,0xFE,0x08,0x20,0x00,0x10,0x00,0xF8,0x3F,0x00,0x11,0x10,0x08,0x20,0x01,0x00,0x7F,0xFC,0x05,0x40,0x09,0x20,0x31,0x18,0xC1,0x06,0x01,0x00};//菜
	unsigned char dan0[] = {0x10,0x10,0x08,0x20,0x04,0x40,0x3F,0xF8,0x21,0x08,0x21,0x08,0x3F,0xF8,0x21,0x08,0x21,0x08,0x3F,0xF8,0x01,0x00,0x01,0x00,0xFF,0xFE,0x01,0x00,0x01,0x00,0x01,0x00};//单
	unsigned char jiao0[] = {0x00,0x00,0x04,0x00,0x0F,0xF0,0x10,0x10,0x30,0x20,0x5F,0xFC,0x20,0x84,0x20,0x84,0x3F,0xFC,0x20,0x84,0x20,0x84,0x20,0x84,0x3F,0xFC,0x20,0x84,0x20,0x84,0x40,0xBC};/*"角"*/
	unsigned char su0[] = {0x00,0x00,0x00,0x00,0x20,0x40,0x27,0xFE,0x10,0x40,0x07,0xFC,0x04,0x44,0x74,0x44,0x14,0x44,0x13,0xF8,0x10,0xF0,0x11,0x58,0x12,0x4C,0x1C,0x46,0x28,0x40,0x46,0xFE};/*"速"*/
	unsigned char du0[] = {0x00,0x00,0x00,0x00,0x00,0x80,0x3F,0xFE,0x44,0x10,0x5F,0xFC,0x44,0x10,0x44,0x10,0x43,0xF0,0x40,0x00,0x5F,0xF8,0x44,0x08,0x42,0x30,0x41,0xC0,0x43,0x60,0xBC,0x1E};/*"度"*/
	unsigned char zhuan0[] = {0x00,0x00,0x00,0x20,0x10,0x20,0x7E,0x20,0x21,0xFE,0x20,0x40,0x40,0x40,0x51,0xFE,0x50,0x40,0x7C,0x40,0x10,0x7E,0x10,0x04,0x3C,0x04,0x10,0x08,0x10,0x70,0x00,0x0E};/*"转"*/
	unsigned char xiang0[] = {0x00,0x00,0x01,0x00,0x01,0x00,0x1F,0xF8,0x20,0x06,0x20,0x02,0x27,0xE2,0x28,0x12,0x28,0x12,0x28,0x12,0x28,0x12,0x28,0x12,0x28,0x12,0x27,0xE2,0x20,0x02,0x20,0x1C};/*"向"*/
	unsigned char zi0[] = {0x00,0x00,0x00,0x00,0x62,0x00,0x13,0xFC,0x04,0x84,0x08,0xC8,0x0D,0x20,0x33,0x10,0x4D,0x0E,0x01,0x00,0x7F,0xFE,0x04,0x20,0x08,0x20,0x07,0x40,0x01,0xF0,0x7E,0x0E};/*"姿",0*/
	unsigned char tai0[] = {0x00,0x00,0x00,0x00,0x01,0x00,0x7F,0xFE,0x01,0x80,0x02,0x40,0x05,0x20,0x19,0x18,0xE0,0x86,0x00,0x00,0x24,0x88,0x24,0x84,0x24,0x54,0x24,0x52,0x44,0x12,0x47,0xF0};/*"态",1*/
	unsigned char jian0[] = {0x00,0x00,0x00,0x00,0x04,0x80,0x24,0xFE,0x24,0x80,0x25,0x00,0x25,0x20,0x26,0x10,0x04,0x08,0x00,0x00,0x3F,0xFC,0x24,0x44,0x24,0x44,0x24,0x44,0x24,0x44,0x7F,0xFE};/*"监"*/
	unsigned char shi0[] = {0x00,0x00,0x00,0x00,0x11,0xFC,0x11,0x04,0x79,0x24,0x09,0x24,0x09,0x24,0x11,0x24,0x19,0x24,0x35,0x34,0x51,0x30,0x10,0x50,0x10,0x50,0x10,0x92,0x11,0x12,0x16,0x1E};/*"视"*/
	unsigned char qi0[] = {0x00,0x00,0x00,0x00,0x3E,0x7C,0x22,0x84,0x22,0x84,0x3E,0x7C,0x01,0x10,0x7F,0xFE,0x04,0x40,0x08,0x30,0x70,0x0E,0x3E,0x7C,0x22,0x84,0x22,0x84,0x22,0x84,0x3E,0x7C};/*"器"*/
	unsigned char tu0[] = {0x00,0x00,0x00,0x00,0x3F,0xFE,0x44,0x02,0x47,0xF2,0x4C,0x22,0x53,0x62,0x40,0x82,0x43,0x62,0x5E,0x1A,0x41,0x82,0x40,0x62,0x43,0x02,0x40,0xC2,0x40,0x22,0x3F,0xFC};/*"图"*/
	unsigned char xiang1[] = {0x00,0x00,0x10,0x80,0x11,0xF0,0x1E,0x10,0x23,0xF8,0x2C,0x46,0x28,0x42,0x67,0xFA,0x60,0x84,0x23,0x46,0x2C,0xB8,0x23,0x20,0x2C,0xF0,0x23,0x28,0x2C,0x26,0x23,0x40};/*"像"*/
	unsigned char xian0[] = {0x00,0x00,0x00,0x00,0x3F,0xFC,0x20,0x04,0x20,0x04,0x3F,0xFC,0x20,0x04,0x20,0x04,0x1F,0xF8,0x24,0x44,0x14,0x48,0x14,0x48,0x14,0x48,0x0C,0x50,0x04,0x40,0x7F,0xFE};/*"显"*/
	unsigned char shi1[] = {0x00,0x00,0x00,0x00,0x3F,0xFC,0x00,0x00,0x00,0x00,0x00,0x00,0x7F,0xFE,0x00,0x80,0x08,0x90,0x08,0x88,0x10,0x88,0x10,0x84,0x20,0x84,0x20,0x82,0x40,0x82,0x07,0x80};/*"示"*/
	unsigned char shu0[] = {0x00,0x00,0x00,0x00,0x25,0x20,0x25,0x20,0x26,0x3E,0x7F,0xA4,0x0E,0x64,0x35,0x64,0x44,0x24,0x08,0x24,0x7F,0x18,0x11,0x18,0x21,0x18,0x1A,0x14,0x06,0x24,0x79,0xC2};/*"数"*/
	unsigned char ju0[] = {0x00,0x00,0x10,0x00,0x11,0xFE,0x11,0x02,0x7D,0x02,0x11,0xFC,0x11,0x10,0x11,0xFE,0x15,0x10,0x1A,0x10,0x72,0x7C,0x12,0x82,0x12,0x82,0x12,0x82,0x14,0x82,0x74,0xFE};/*"据"*/
	unsigned char fa0[] = {0x00,0x00,0x01,0x00,0x11,0x30,0x21,0x08,0x22,0x00,0x3F,0xFE,0x02,0x00,0x02,0x00,0x07,0xFC,0x05,0x08,0x08,0x88,0x08,0x90,0x10,0x60,0x20,0x60,0x41,0x98,0x0E,0x06};/*"发"*/
	unsigned char song0[] = {0x00,0x00,0x00,0x00,0x22,0x04,0x21,0x08,0x10,0x90,0x03,0xFC,0x60,0x40,0x10,0x40,0x17,0xFE,0x10,0x40,0x10,0x40,0x10,0xB0,0x11,0x08,0x12,0x04,0x2C,0x00,0x47,0xFE};/*"送"*/

//	行索引
	switch(index){
		case 0:
		//	列索引
			switch(num){
				case 0://图像显示
					for(i = 0; i < 32; i++) first_nom[i] = tu0[i];
					for(i = 0; i < 32; i++) first_nom[32+i] = xiang1[i];
					for(i = 0; i < 32; i++) first_nom[64+i] = xian0[i];
					for(i = 0; i < 32; i++) first_nom[96+i] = shi1[i];
					return 4;
					break;
				case 1://数据发送
					for(i = 0; i < 32; i++) first_nom[i] = shu0[i];
					for(i = 0; i < 32; i++) first_nom[32+i] = ju0[i];
					for(i = 0; i < 32; i++) first_nom[64+i] = fa0[i];
					for(i = 0; i < 32; i++) first_nom[96+i] = song0[i];
					return 4;
				case 2://黑体
					for(i = 0; i < 32; i++) first_nom[i] = hei0[i];
					for(i = 0; i < 32; i++) first_nom[32+i] = ti0[i];
					return 2;
			}
			break;
		case 1:
			switch(num){
				case 0://角速度
					for(i = 0; i < 32; i++) first_nom[i] = jiao0[i];
					for(i = 0; i < 32; i++) first_nom[32+i] = su0[i];
					for(i = 0; i < 32; i++) first_nom[64+i] = du0[i];
					return 3;
					break;
				case 1://角度
					for(i = 0; i < 32; i++) first_nom[i] = jiao0[i];
					for(i = 0; i < 32; i++) first_nom[32+i] = du0[i];
					return 2;
				case 2://速度
					for(i = 0; i < 32; i++) first_nom[i] = su0[i];
					for(i = 0; i < 32; i++) first_nom[32+i] = du0[i];
					return 2;
				case 3://转向
					for(i = 0; i < 32; i++) first_nom[i] = zhuan0[i];
					for(i = 0; i < 32; i++) first_nom[32+i] = xiang0[i];
					return 2;
			}
			break;
		case 2:
			switch(num){
				case 0://姿态
					for(i = 0; i < 32; i++) first_nom[i] = zi0[i];
					for(i = 0; i < 32; i++) first_nom[32+i] = tai0[i];
					return 2;
					break;
				case 1://幼圆
					for(i = 0; i < 32; i++) first_nom[i] = you0[i];
					for(i = 0; i < 32; i++) first_nom[32+i] = yuan0[i];
					return 2;
				case 2://黑体
					for(i = 0; i < 32; i++) first_nom[i] = hei0[i];
					for(i = 0; i < 32; i++) first_nom[32+i] = ti0[i];
					return 2;
			}
			break;
		case 3:
			switch(num){
				case 0://监视器
					for(i = 0; i < 32; i++) first_nom[i] = jian0[i];
					for(i = 0; i < 32; i++) first_nom[32+i] = shi0[i];
					for(i = 0; i < 32; i++) first_nom[64+i] = qi0[i];
					return 3;
					break;
				case 1://幼圆
					for(i = 0; i < 32; i++) first_nom[i] = you0[i];
					for(i = 0; i < 32; i++) first_nom[32+i] = yuan0[i];
					return 2;
				case 2://黑体
					for(i = 0; i < 32; i++) first_nom[i] = hei0[i];
					for(i = 0; i < 32; i++) first_nom[32+i] = ti0[i];
					return 2;
			}
			break;
		case 67://菜单
			for(i = 0; i < 32; i++) first_nom[i] = cai0[i];
			for(i = 0; i < 32; i++) first_nom[32+i] = dan0[i];
			return 2;
			break;
	}
	return 0;
}
/*------------------------------*/
/*		   菜单显示模块			*/
/*==============================*/
static void display(char index, char menu[rows]){
//	变量定义
	char show_index[rows];
//	清屏
	ips200_clear(WHITE);
//	计算显示索引
	if(index-1<0) show_index[0] = rows-1;
	else show_index[0] = index - 1;

	show_index[1] = index;

	if(index+1>rows-1) show_index[2] = 0,show_index[3] = 1;
	else if(index+2>rows-1) show_index[2] = index+1,show_index[3] = 0;
	else show_index[2] = index+1,show_index[3] = index+2;
//	菜单显示
	ips200_display_chinese(0, 208, 16, first_nom, info(67, menu[show_index[0]]), 0XFDF8);
	ips200_display_chinese(0, 224, 16, first_nom, info(show_index[0], menu[show_index[0]]), 0xB6DB);
	
	ips200_display_chinese(0, 256, 16, first_nom, info(show_index[1], menu[show_index[1]]), 0xB6DB);
	
	ips200_display_chinese(0, 288, 16, first_nom, info(show_index[2], menu[show_index[2]]), 0xB6DB);
	ips200_display_chinese(0, 304, 16, first_nom, info(show_index[3], menu[show_index[3]]), 0xB6DB);
}
/*------------------------------*/
/*		 菜单阈值限制模块		*/
/*==============================*/
static char menu_limit(char index, char num){
//	限制列索引值
	switch(index){
		case 0:if(num<limit0) return 1;break;
		case 1:if(num<limit1) return 1;break;
		case 2:if(num<limit2) return 1;break;
		case 3:if(num<limit3) return 1;break;
	}
	return 0;
}
/*------------------------------*/
/*		 按键过渡菜单模块		*/
/*==============================*/
//static void menu_selection(unsigned char event){
////	变量定义
//	static char menu[4];
//	static char index;
//	static char menu_level;
////	一级菜单
//	if(!menu_level){
//	//	菜单事件分支
//		switch(event){
//			case 6://右按键
//				if(menu_limit(index, menu[index])) menu[index]++;
//				else return;
//				break;
//			
//			case 4://左按键
//				if(menu[index] > 0) menu[index]--;
//				else return;
//				break;
//			
//			case 2://上按键
//				if(index>0) index--;
//				else index = index_limit;
//				break;
//			
//			case 5://下按键
//				if(index<index_limit) index++;
//				else index = 0;
//				break;
//			
//			case 1://确定键
//			//	初始化二级菜单
//				menu2_init(index, menu[index]);
//				menu2display(index);
//				menu_level = 1;
//				return;
//			case 3:break;
//		}
//		display(index, &menu[0]);
//	}
////	次级菜单
//	else{	
//		switch(event){
//			case 3://返回键 
//				menu_level = 0;
//				menu2_slect(event);
//				display(index, &menu[0]);
//				break;
//			
//			default://其他按键
//				menu2_slect(event);
//				break; 
//		}
//	}
//}

//----------------------------分割线----------------------------//
/*--------------------------------------------------------------*/
/* 							 按键部分 							*/
/*==============================================================*/
/*------------------------------*/
/*		 引脚状态反转模块		*/
/*==============================*/
//void dir(unsigned char dirc){
//	switch(dirc){
//	//	默认方向
//		case 0:
//		//	变更方向
//			gpio_dir(column1,GPO);
//			gpio_dir(column2,GPO);
//			gpio_dir(column3,GPO);		
//			gpio_dir(row1,GPI);
//			gpio_dir(row2,GPI);
//		//	变更状态
//			gpio_set(column1, 0);
//			gpio_set(column2, 0);
//			gpio_set(column3, 0);
//			gpio_set(row1, 1);
//			gpio_set(row2, 1);
//		break;
//	//	反转方向
//		case 1:	
//		//	变更方向
//			gpio_dir(column1,GPI);
//			gpio_dir(column2,GPI);
//			gpio_dir(column3,GPI);			
//			gpio_dir(row1,GPO);
//			gpio_dir(row2,GPO);			
//		//	变更状态
//			gpio_set(column1, 1);
//			gpio_set(column2, 1);
//			gpio_set(column3, 1);
//			gpio_set(row1, 0);
//			gpio_set(row2, 0);
//		break;
//	}
//}
/*------------------------------*/
/*		   列值判断模块			*/
/*==============================*/
//static unsigned char col_jug(void){
////	返回触发列数
//	if(gpio_get(column1) == 0) return 1;                                      				
//	else if(gpio_get(column2) == 0) return 2;                                       			
//	else return 3;                                       			
//}
/*------------------------------*/
/*		   按键判断模块			*/
/*==============================*/
//void trig_jug(void){
////	char menu[4] = {0,1,2,0};
////	display(2, menu);
////	第一行触发
//	if(!(gpio_get(row1))){
//		dir(1);
//		menu_selection(0+col_jug());
//		dir(0);
//		while(!(gpio_get(row1)));
//	}
////	第二行触发
//	if(!(gpio_get(row2))){
//		dir(1);
//		menu_selection(3+col_jug());
//		dir(0);
//		while(!(gpio_get(row2)));
//	}
//}
