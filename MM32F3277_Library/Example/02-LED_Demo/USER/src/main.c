/*********************************************************************************************************************
* COPYRIGHT NOTICE
* Copyright (c) 2019,逐飞科技
* All rights reserved.
* 技术讨论QQ群：一群：179029047(已满)  二群：244861897
*
* 以下所有内容版权均属逐飞科技所有，未经允许不得用于商业用途，
* 欢迎各位使用并传播本程序，修改内容时必须保留逐飞科技的版权声明。
*
* @file				main
* @company			成都逐飞科技有限公司
* @author			逐飞科技(QQ3184284598)
* @version			查看doc内version文件 版本说明
* @Software			IAR 8.3 or MDK 5.24
* @Target core		MM32F3277
* @Taobao			https://seekfree.taobao.com/
* @date				2021-02-22
********************************************************************************************************************/

#include "headfile.h"

// *************************** 例程说明 ***************************
// 
// 测试需要准备逐飞科技 MM32F3277 核心板一块
// 
// 调试下载需要准备逐飞科技 CMSIS-DAP 调试下载器 或 ARM 调试下载器 一个
// 
// 本例程初始化了逐飞科技 MM32F3277 核心板上的 B13/H2 两个LED对应的引脚
// 并初始化了一个引脚作为按键输入 该引脚可修改
// 
// 烧录本例程后 可见 B13 对应LED闪烁 按键输入引脚输入高电平时 H2 亮起
// 
// 打开新的工程或者工程移动了位置务必执行以下操作
// 第一步 关闭上面所有打开的文件
// 第二步 project->clean  等待下方进度条走完
// 
// *************************** 例程说明 ***************************

// **************************** 宏定义 ****************************
#define LED1				B13
#define LED2				H2
#define KEY					D0
// **************************** 宏定义 ****************************

// **************************** 变量定义 ****************************
uint16 loop_count = 0;
uint8 io_input_state = 0;
// **************************** 变量定义 ****************************

// **************************** 代码区域 ****************************
int main(void)
{
	board_init(true);																// 初始化 debug 输出串口

	//此处编写用户代码(例如：外设初始化代码等)
	gpio_init(KEY, GPI, GPIO_HIGH, GPI_PULL_UP);									// 初始化引脚为上拉输入 默认高电平
	gpio_init(LED1, GPO, GPIO_HIGH, GPO_PUSH_PULL);									// 初始化引脚为推挽输出 默认高电平
	gpio_init(LED2, GPO, GPIO_HIGH, GPO_PUSH_PULL);									// 初始化引脚为推挽输出 默认高电平
	//此处编写用户代码(例如：外设初始化代码等)

	while(1)
	{
		if(loop_count < 50)															// 500ms
			gpio_set(LED1, 1);														// 输出高 灭灯
		else if(loop_count >= 50 && loop_count < 100)								// 500ms
			gpio_set(LED1, 0);														// 输出低 亮灯
		else
			loop_count = 0;															// 清空计时

		io_input_state = gpio_get(KEY);												// 获取输入引脚电平
		if(io_input_state)															// 高电平
			gpio_set(LED2, 1);														// 输出低 灭灯
		else																		// 高电低
			gpio_set(LED2, 0);														// 输出高 亮灯

		loop_count++;																// 计时自增
		systick_delay_ms(10);														// 时间间隔 10ms
	}
}
// **************************** 代码区域 ****************************
